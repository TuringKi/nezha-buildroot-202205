## package/rtl8723ds/Config.in
```kconfig
config BR2_PACKAGE_RTL8723DS
	bool "rtl8723ds"
	depends on BR2_LINUX_KERNEL
	help
	  rtl8723ds wifi driver

	  https://gitee.com/chrithon_official/rtl8723ds-linux

comment "rtl8723ds needs a Linux kernel to be built"
	depends on !BR2_LINUX_KERNEL
```
